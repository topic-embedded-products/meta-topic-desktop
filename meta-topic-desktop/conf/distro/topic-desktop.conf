## meta-topic-desktop/conf/distro/topic-desktop.conf
```bitbake
# Desktop distribution, using busybox for hotplug and login.

DISTRO_VERSION = "topic-desktop.0"

# providers
PREFERRED_PROVIDER_libcrypto = "openssl"
PREFERRED_PROVIDER_libssl = "openssl"
PREFERRED_PROVIDER_jpeg = "libjpeg-turbo"
PREFERRED_PROVIDER_jpeg-native = "libjpeg-turbo-native"

# http://www.yoctoproject.org/docs/current/dev-manual/dev-manual.html#selecting-an-initialization-manager
VIRTUAL-RUNTIME_init_manager = "systemd"
DISTRO_FEATURES_BACKFILL_CONSIDERED = "sysvinit"
VIRTUAL-RUNTIME_initscripts = ""
# We want to have a network
PACKAGECONFIG_append_pn-systemd = " resolved networkd"

DISTRO_FEATURES = "systemd usbgadget usbhost wifi bluetooth x11 touchscreen mouse keyboard pulseaudio opengl largefile ${DISTRO_FEATURES_LIBC} polkit"

# don't run login on root console, messes with GUI
USE_VT = "0"
SYSVINIT_ENABLED_GETTYS = ""

# build some core libs with heavier compiler optimization
O3_OPT = "-O3 -pipe ${DEBUG_FLAGS}"
FULL_OPTIMIZATION_pn-libgcrypt = "${O3_OPT}"
FULL_OPTIMIZATION_pn-zlib = "${O3_OPT}"

# Allow licenses for gstreamer components (consult your legal department...)
# The "xilinx" license is to obtain libmali
LICENSE_FLAGS_WHITELIST ?= "commercial xilinx"
COMMERCIAL_AUDIO_PLUGINS ?= "gst-plugins-ugly-mad gst-plugins-ugly-mpegaudioparse"
COMMERCIAL_VIDEO_PLUGINS ?= "gst-plugins-ugly-mpeg2dec gst-plugins-ugly-mpegstream gst-plugins-bad-mpegvideoparse"

# Prevent stacking up hundreds of old builds by not including a DATETIME in the image name
IMAGE_NAME = "${IMAGE_BASENAME}-${MACHINE}"

# Package feed, defaults to build host's local (avahi) name
DISTRO_HOST_NAME ?= "${@os.uname()[1]}.local"
DISTRO_HOST_NAME_TOPICDESKTOP ?= "${DISTRO_HOST_NAME}"
DISTRO_FEED_NAME ?= "topic-desktop-feed"
DISTRO_FEED_PREFIX = "topic"
DISTRO_FEED_URI = "http://${DISTRO_HOST_NAME_TOPICDESKTOP}/${DISTRO_FEED_NAME}"
# Each machine should build its own package, otherwise all feeds will point
# to the sstate server.
DISTRO_HOST_NAME_TOPICDESKTOP[vardepvalue] = "${DISTRO_HOST_NAME_TOPICDESKTOP}"
```

## scripts/templates/build/conf/bblayers.conf
```bitbake
# LAYER_CONF_VERSION is increased each time build/conf/bblayers.conf
# changes incompatibly
LCONF_VERSION = "7"

# Top dir is three dirs back
LAYERTOPDIR := "${@os.path.dirname(os.path.dirname(os.path.dirname(d.getVar('FILE', True))))}"

BBPATH = "${TOPDIR}"
BBFILES ?= ""

BBLAYERS = " \
  ${LAYERTOPDIR}/topic-platform/oe-core/meta \
  ${LAYERTOPDIR}/topic-platform/meta-oe/meta-oe \
  ${LAYERTOPDIR}/topic-platform/meta-oe/meta-xfce \
  ${LAYERTOPDIR}/topic-platform/meta-oe/meta-multimedia \
  ${LAYERTOPDIR}/topic-platform/meta-oe/meta-networking \
  ${LAYERTOPDIR}/topic-platform/meta-oe/meta-gnome \
  ${LAYERTOPDIR}/topic-platform/meta-oe/meta-python \
  ${LAYERTOPDIR}/topic-platform/meta-xilinx/meta-xilinx-bsp \
  ${LAYERTOPDIR}/topic-platform/meta-xilinx/meta-xilinx-standalone \
  ${LAYERTOPDIR}/topic-platform/meta-topic \
  ${LAYERTOPDIR}/meta-dyplo \
  ${LAYERTOPDIR}/meta-clang \
  ${LAYERTOPDIR}/meta-rust \
  ${LAYERTOPDIR}/meta-browser \
  ${LAYERTOPDIR}/meta-topic-desktop \
  "
```
